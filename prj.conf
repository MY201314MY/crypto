## CMakeLists.txt
```
# SPDX-License-Identifier: Apache-2.0

cmake_minimum_required(VERSION 3.20.0)

find_package(Zephyr REQUIRED HINTS $ENV{ZEPHYR_BASE})
project(hello_world)

# Configure cryptoauthlib
SET(ATCA_BUILD_SHARED_LIBS OFF CACHE INTERNAL "")
SET(ATCA_PRINTF ON CACHE INTERNAL "")
SET(ATCA_HAL_I2C ON CACHE INTERNAL "")
SET(ATCA_NO_HEAP ON CACHE INTERNAL "")
add_subdirectory(cryptoauthlib/lib)

include_directories(app ${CMAKE_CURRENT_BINARY_DIR}/cryptoauthlib/lib 
                        ${CMAKE_CURRENT_SOURCE_DIR}/cryptoauthlib
                        ${CMAKE_CURRENT_SOURCE_DIR}/cryptoauthlib/lib
                        ${CMAKE_CURRENT_SOURCE_DIR}/cryptoauthlib/third_party/hal/zephyr)
                  
target_link_libraries(cryptoauth PUBLIC zephyr_interface)
target_link_libraries(app PUBLIC cryptoauth)

target_sources(app PRIVATE src/main.c)
```

## prj.conf
```kconfig
# nothing here
CONFIG_RTIO=y
CONFIG_RTIO_SYS_MEM_BLOCKS=y
```

## src/main.c
```c
/*
 * Copyright (c) 2012-2014 Wind River Systems, Inc.
 *
 * SPDX-License-Identifier: Apache-2.0
 */

#include <stdio.h>
#include <zephyr/kernel.h>
#include <cryptoauthlib.h>

#define AES_CONFIG_ENABLE_BIT_MASK 0x01

int main(void)
{
	uint8_t revision[4] = {0};
	ATCA_STATUS status = atcab_info(revision);
	
	if(status == ATCA_SUCCESS)
	{
		for(uint8_t i=0;i<4;i++)
		{
			printf("%02X ", revision[i]);
		}
		printf("\r\n");
	}

	uint8_t aes_enable;

	status = atcab_read_bytes_zone(ATCA_ZONE_CONFIG, 0, 13, &aes_enable, 1);
	if ((aes_enable & AES_CONFIG_ENABLE_BIT_MASK) == 0)
	{
		printf("Ignoring the test, AES is not enabled in config zone");
	}

	printf("Hello World! %s\n", CONFIG_BOARD);

	return 0;
}
```
